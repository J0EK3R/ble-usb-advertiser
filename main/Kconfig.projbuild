## main/Kconfig.projbuild
```kconfig
menu "BC2 USB Advertiser"

    config BC2ADV_MAX_SETS
        int "Maximum number of simultaneous advertising sets"
        range 1 5
        default 5
        help
            Upper limit reported in HELLO_RSP. The effective value is
            min(this, CONFIG_BT_NIMBLE_MAX_EXT_ADV_INSTANCES + 1).

    config BC2ADV_ENABLE_GATT
        bool "Enable scanner and GATT central (protocol 1.1)"
        default y
        help
            Adds the BLE scanner and up to BC2ADV_MAX_CONNS GATT connections next to the advertising sets.
            Without it the firmware behaves like version 0.1 (HELLO_RSP announces no GATT support).

    config BC2ADV_MAX_CONNS
        int "Maximum number of simultaneous GATT connections"
        depends on BC2ADV_ENABLE_GATT
        range 1 16
        default 4
        help
            Upper limit reported in HELLO_RSP. The effective value is the smaller of this setting and
            CONFIG_BT_NIMBLE_MAX_CONNECTIONS. The controller shares CONFIG_BT_CTRL_BLE_MAX_ACT (max. 10 on
            the ESP32-S3) between the advertising sets, the scan and the links, so the default 4 is the
            expected ceiling with 5 advertising sets and a running scan (10 - 5 - 1). The real maximum is
            verified on hardware with `bc2adv.py connspike` (docs/verification.md); to try more, raise
            this value and CONFIG_BT_NIMBLE_MAX_CONNECTIONS together.

    config BC2ADV_LED_BRIGHTNESS
        int "RGB LED brightness (0..255)"
        range 1 255
        default 20
        help
            The WS2812 LED is very bright, so the channel values are scaled.

endmenu
```
